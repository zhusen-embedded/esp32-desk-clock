## sdkconfig.defaults
```kconfig
# 单 app 分区即可，桌面时钟不做 OTA
CONFIG_ESPTOOLPY_FLASHSIZE_4MB=y

# LVGL + Bluedroid + 48 px 字体链进去约 1.5 MB，默认 1 MB app 分区不够，
# 用自定义分区表给 app 3 MB
CONFIG_PARTITION_TABLE_CUSTOM=y
CONFIG_PARTITION_TABLE_CUSTOM_FILENAME="partitions.csv"

# PSRAM 用于 LVGL 缓冲（有则开，无则走内部 RAM 的双 40 行缓冲）
CONFIG_SPIRAM=y
CONFIG_SPIRAM_MODE_OCT=y
CONFIG_SPIRAM_SPEED_80M=y

# 双缓冲需要 PSRAM，LVGL 配 16 位色深
CONFIG_LV_COLOR_DEPTH_16=y
CONFIG_LV_MEM_CUSTOM=y
CONFIG_LV_MEM_SIZE_KILOBYTES=64

# 字体：表盘用 48 号大字，日期/标签用 20 号
CONFIG_LV_FONT_MONTSERRAT_14=y
CONFIG_LV_FONT_MONTSERRAT_20=y
CONFIG_LV_FONT_MONTSERRAT_48=y
CONFIG_LV_FONT_DEFAULT_MONTSERRAT_14=y

# 中文界面需要 CJK 字体（否则「已同步」显示成方块）
CONFIG_LV_FONT_SOURCE_HAN_SANS_SC_14_CJK=y
CONFIG_LV_FONT_SOURCE_HAN_SANS_SC_16_CJK=y

# BLE 配网
CONFIG_BT_ENABLED=y
CONFIG_BT_BLUEDROID_ENABLED=y
CONFIG_BT_BLE_ENABLED=y

# Wi-Fi 省电：modem sleep 是待机 0.35 W 的关键
CONFIG_ESP_WIFI_SLP_IRAM_OPT=y
CONFIG_ESP_PHY_MAC_BB_PD=y

# 任务看门狗
CONFIG_ESP_TASK_WDT_INIT=y
CONFIG_ESP_TASK_WDT_TIMEOUT_S=10
```
